## config/west.yml
```yaml
manifest:
  remotes:
    - name: zmkfirmware
      url-base: https://github.com/pashutk
  projects:
    - name: zmk
      remote: zmkfirmware
      revision: nrf52833
      import: app/west.yml
  self:
    path: config
```
